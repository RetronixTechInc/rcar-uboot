## board/renesas/hel/Kconfig
```kconfig
if TARGET_HEL

config SYS_SOC
	default "rmobile"

config SYS_BOARD
	default "hel"

config SYS_VENDOR
	default "renesas"

config SYS_CONFIG_NAME
	default "hel"

endif
```

## board/renesas/raptor/Kconfig
```kconfig
if TARGET_RAPTOR

config SYS_SOC
	default "rmobile"

config SYS_BOARD
	default "raptor"

config SYS_VENDOR
	default "renesas"

config SYS_CONFIG_NAME
	default "raptor"

endif
```

## board/renesas/sbc/Kconfig
```kconfig
if TARGET_SBC

config SYS_SOC
	default "rmobile"

config SYS_BOARD
	default "sbc"

config SYS_VENDOR
	default "renesas"

config SYS_CONFIG_NAME
	default "sbc"

endif
```
