// SPDX-License-Identifier: GPL-2.0
/*
 * Device Tree Source extras for U-Boot for the Raptor board
 *
 * Copyright (C) 2021 Renesas Electronics Corp.
 */

#include "r8a779g0-raptor.dts"
#include "r8a779g0-u-boot.dtsi"



